## boards/shields/psk/Kconfig.defconfig
```kconfig
if SHIELD_CALDERA_LEFT

config ZMK_KEYBOARD_NAME
    default "PSK"

config ZMK_SPLIT_ROLE_CENTRAL
    default y

endif

if SHIELD_PSK_LEFT || SHIELD_PSK_RIGHT

config ZMK_SPLIT
    default y

endif
```

## boards/shields/psk/Kconfig.shield
```kconfig
config SHIELD_PSK_LEFT
    def_bool $(shields_list_contains,psk_left)

config SHIELD_PSK_RIGHT
    def_bool $(shields_list_contains,psk_right)
```
